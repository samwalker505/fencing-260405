## sdkconfig.defaults
```kconfig
# LilyGO T-Display S3 (ESP32-S3, parallel I80 ST7789, 320x170 landscape).
#   idf.py set-target esp32s3 fullclean build
CONFIG_LV_HOR_RES_MAX=320
CONFIG_LV_VER_RES_MAX=170
CONFIG_LV_FONT_MONTSERRAT_28=y
CONFIG_LV_FONT_MONTSERRAT_40=y
CONFIG_BT_ENABLED=y
CONFIG_BT_BLUEDROID_ENABLED=y
CONFIG_BT_NIMBLE_ENABLED=n
CONFIG_BT_BLE_ENABLED=y
```
